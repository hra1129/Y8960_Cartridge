// --------------------------------------------------------------------
//	OPL2 wrapper ADPCM synthesis from CPU test (R#07 = 80h)
//	Uses the real 3.579545MHz enable pulse. The CPU writes the ADPCM
//	data to R#0F polling BUF_RDY, and every decoded value is compared
//	with ..\test002\ref.txt (generated by ..\test002\gen_adpcm.py).
// --------------------------------------------------------------------
module tb ();
	localparam	clk_base	= 1_000_000_000_000.0 / 42_954_540;
	localparam	c_bytes		= 600;
	localparam	c_nibbles	= c_bytes * 2;
	localparam	c_delta_n	= 16'h8000;
	//	one cen55 every 72 enables, one enable every 12 clocks
	localparam	c_cen55_clks	= 72 * 12;
	localparam	c_nibble_clks	= 65536 / c_delta_n * c_cen55_clks;

	reg					clk;
	reg					reset_n;
	reg					enable;
	reg		[3:0]		ff_divider;
	reg					bus_cs;
	reg					bus_address;
	reg					bus_write;
	reg					bus_valid;
	reg		[7:0]		bus_wdata;
	wire				bus_ready;
	wire	[7:0]		bus_rdata;
	wire				bus_rdata_en;
	wire	[15:0]		opl2_sound_out_l;
	wire	[15:0]		opl2_sound_out_r;
	wire				intr_n;
	wire				adpcm_write;
	wire				adpcm_valid;
	wire				adpcm_ready;
	wire	[17:0]		adpcm_address;
	wire	[7:0]		adpcm_wdata;
	reg		[7:0]		adpcm_rdata;
	reg					adpcm_rdata_en;
	reg					test_passed;

	reg		[7:0]		src [0:c_bytes-1];
	integer				ref_value [0:c_nibbles-1];
	reg		[1:0]		ff_wait;
	integer				decoded_count;
	integer				last_decode_clk;
	integer				max_decode_gap;
	integer				clk_count;
	integer				max_abs_out;
	integer				mem_requests;

	opl2 u_dut (
		.clk				( clk				),
		.reset_n			( reset_n			),
		.enable				( enable			),
		.bus_cs				( bus_cs			),
		.bus_address		( bus_address		),
		.bus_write			( bus_write			),
		.bus_valid			( bus_valid			),
		.bus_ready			( bus_ready			),
		.bus_wdata			( bus_wdata			),
		.bus_rdata			( bus_rdata			),
		.bus_rdata_en		( bus_rdata_en		),
		.opl2_sound_out_l	( opl2_sound_out_l	),
		.opl2_sound_out_r	( opl2_sound_out_r	),
		.intr_n				( intr_n			),
		.adpcm_write		( adpcm_write		),
		.adpcm_valid		( adpcm_valid		),
		.adpcm_ready		( adpcm_ready		),
		.adpcm_address		( adpcm_address		),
		.adpcm_wdata		( adpcm_wdata		),
		.adpcm_rdata		( adpcm_rdata		),
		.adpcm_rdata_en		( adpcm_rdata_en	)
	);

	always #(clk_base/2) clk = ~clk;

	//	Same enable as y8960_cartridge_tangprimer25k.v (one clock in 12)
	always @( posedge clk ) begin
		if( !reset_n ) begin
			ff_divider	<= 4'd0;
			enable		<= 1'b0;
		end
		else if( ff_divider == 4'd11 ) begin
			ff_divider	<= 4'd0;
			enable		<= 1'b1;
		end
		else begin
			ff_divider	<= ff_divider + 4'd1;
			enable		<= 1'b0;
		end
	end

	//	SRAM model: the memory must not be accessed in this mode.
	assign adpcm_ready = adpcm_valid & (ff_wait == 2'd2);

	always @( posedge clk ) begin
		if( !reset_n ) begin
			ff_wait			<= 2'd0;
			adpcm_rdata_en	<= 1'b0;
			adpcm_rdata		<= 8'h00;
		end
		else begin
			if( adpcm_valid && !adpcm_ready ) begin
				ff_wait	<= ff_wait + 2'd1;
			end
			else begin
				ff_wait	<= 2'd0;
			end
			adpcm_rdata_en	<= adpcm_valid & adpcm_ready & ~adpcm_write;
			adpcm_rdata		<= 8'h00;
		end
	end

	always @( posedge clk ) begin
		clk_count = clk_count + 1;
		if( reset_n && adpcm_valid && adpcm_ready ) begin
			mem_requests = mem_requests + 1;
		end
	end

	//	Check each decoded value. The decoder pipeline advances on enable,
	//	so the result is read well before the next nibble.
	always @( posedge clk ) begin
		if( u_dut.u_adpcm.u_adpcm.u_decoder.cen &&
		    u_dut.u_adpcm.u_adpcm.u_decoder.adv &&
		    u_dut.u_adpcm.u_adpcm.u_decoder.chon ) begin
			if( decoded_count > 0 && clk_count - last_decode_clk > max_decode_gap ) begin
				max_decode_gap = clk_count - last_decode_clk;
			end
			last_decode_clk = clk_count;
			repeat( 200 ) @( posedge clk );
			if( decoded_count < c_nibbles ) begin
				if( $signed( u_dut.u_adpcm.u_adpcm.u_decoder.x1 ) !== ref_value[ decoded_count ] ) begin
					$fatal( 1, "decoded[%0d] expected %0d, actual %0d", decoded_count,
						ref_value[ decoded_count ], $signed( u_dut.u_adpcm.u_adpcm.u_decoder.x1 ) );
				end
			end
			decoded_count = decoded_count + 1;
		end
	end

	//	The jtopl2 output stays X for a while in simulation, so measure the
	//	ADPCM path latched in opl2.v.
	always @( posedge clk ) begin
		if( !$isunknown( u_dut.ff_adpcm_sound_out_l ) ) begin
			if( $signed( u_dut.ff_adpcm_sound_out_l ) > max_abs_out ) max_abs_out = $signed( u_dut.ff_adpcm_sound_out_l );
			if( -$signed( u_dut.ff_adpcm_sound_out_l ) > max_abs_out ) max_abs_out = -$signed( u_dut.ff_adpcm_sound_out_l );
		end
	end

	// ---------------------------------------------------------
	//	Bus tasks
	// ---------------------------------------------------------
	task bus_write_cycle( input a, input [7:0] d );
		@( posedge clk );
		bus_cs		<= 1'b1;
		bus_valid	<= 1'b1;
		bus_write	<= 1'b1;
		bus_address	<= a;
		bus_wdata	<= d;
		@( posedge clk );
		bus_cs		<= 1'b0;
		bus_valid	<= 1'b0;
		bus_write	<= 1'b0;
		repeat( 40 ) @( posedge clk );
	endtask

	task bus_read_cycle( input a, output [7:0] d );
		integer timeout;
		@( posedge clk );
		bus_cs		<= 1'b1;
		bus_valid	<= 1'b1;
		bus_write	<= 1'b0;
		bus_address	<= a;
		@( posedge clk );
		bus_cs		<= 1'b0;
		bus_valid	<= 1'b0;
		timeout		= 0;
		#1;
		while( !bus_rdata_en ) begin
			@( posedge clk );
			#1;
			timeout = timeout + 1;
			if( timeout > 100 ) $fatal( 1, "bus read timeout" );
		end
		d = bus_rdata;
		repeat( 40 ) @( posedge clk );
	endtask

	task write_reg( input [7:0] address, input [7:0] data );
		bus_write_cycle( 1'b0, address );
		bus_write_cycle( 1'b1, data );
	endtask

	task read_status( output [7:0] st );
		bus_read_cycle( 1'b0, st );
	endtask

	task wait_buf_rdy;
		reg		[7:0]	st;
		integer			timeout;
		begin
			timeout = 0;
			read_status( st );
			while( !st[3] ) begin
				if( st[4] ) $fatal( 1, "EOS is set in CPU synthesis mode (status %02h)", st );
				if( !st[0] ) $fatal( 1, "PCM_BSY is cleared in CPU synthesis mode (status %02h)", st );
				timeout = timeout + 1;
				if( timeout > 200 ) $fatal( 1, "BUF_RDY timeout" );
				read_status( st );
			end
		end
	endtask

	// ---------------------------------------------------------
	//	Test sequence
	// ---------------------------------------------------------
	integer		i;
	integer		fd;
	integer		value;
	integer		n;
	reg	[7:0]	st;

	initial begin
		clk				= 1'b0;
		reset_n			= 1'b0;
		bus_cs			= 1'b0;
		bus_address		= 1'b0;
		bus_write		= 1'b0;
		bus_valid		= 1'b0;
		bus_wdata		= 8'd0;
		test_passed		= 1'b0;
		decoded_count	= 0;
		last_decode_clk	= 0;
		max_decode_gap	= 0;
		clk_count		= 0;
		max_abs_out		= 0;
		mem_requests	= 0;
		$readmemh( "..\\test002\\adpcm.hex", src );
		fd = $fopen( "..\\test002\\ref.txt", "r" );
		if( fd == 0 ) $fatal( 1, "..\\test002\\ref.txt not found" );
		for( i = 0; i < c_nibbles; i = i + 1 ) begin
			if( $fscanf( fd, "%d", value ) != 1 ) $fatal( 1, "ref.txt is too short" );
			ref_value[i] = value;
		end
		$fclose( fd );

		repeat( 20 ) @( posedge clk );
		reset_n = 1'b1;
		repeat( 20 ) @( posedge clk );

		//	Unmask EOS / BUF_RDY, and set up the synthesis parameters
		write_reg( 8'h04, 8'h00 );
		write_reg( 8'h07, 8'h01 );
		write_reg( 8'h10, c_delta_n[7:0] );
		write_reg( 8'h11, c_delta_n[15:8] );
		write_reg( 8'h12, 8'hFF );

		//	Start synthesis from CPU, then supply the data polling BUF_RDY.
		write_reg( 8'h07, 8'h80 );
		write_reg( 8'h0F, src[0] );
		read_status( st );
		if( st[3] ) $fatal( 1, "BUF_RDY must be 0 after writing R#0F (status %02h)", st );
		if( !st[0] ) $fatal( 1, "PCM_BSY must be 1 in CPU synthesis mode (status %02h)", st );
		for( i = 1; i < c_bytes; i = i + 1 ) begin
			wait_buf_rdy;
			write_reg( 8'h0F, src[i] );
		end

		//	Wait for the last nibble, then check that synthesis continues without EOS.
		n = 0;
		while( decoded_count < c_nibbles + 4 ) begin
			@( posedge clk );
			n = n + 1;
			if( n > c_nibble_clks * 10 ) $fatal( 1, "decoding stopped at %0d nibbles", decoded_count );
		end
		read_status( st );
		if( st[4] ) $fatal( 1, "EOS is set in CPU synthesis mode (status %02h)", st );
		if( !st[0] ) $fatal( 1, "PCM_BSY must stay 1 in CPU synthesis mode (status %02h)", st );
		if( !u_dut.u_adpcm.reg_start ) $fatal( 1, "START is cleared in CPU synthesis mode" );
		if( mem_requests != 0 ) $fatal( 1, "ADPCM memory was accessed %0d times", mem_requests );
		if( max_decode_gap < c_nibble_clks - 24 || max_decode_gap > c_nibble_clks + 24 ) begin
			$fatal( 1, "nibble period %0d clocks, expected %0d", max_decode_gap, c_nibble_clks );
		end
		if( max_abs_out < 4096 ) begin
			$fatal( 1, "ADPCM output is too small (%0d)", max_abs_out );
		end

		//	Stop
		write_reg( 8'h07, 8'h00 );
		repeat( c_cen55_clks * 4 ) @( posedge clk );
		read_status( st );
		if( st[0] ) $fatal( 1, "PCM_BSY must be 0 after stop (status %02h)", st );
		if( u_dut.ff_adpcm_sound_out_l !== 16'd0 || u_dut.ff_adpcm_sound_out_r !== 16'd0 ) begin
			$fatal( 1, "ADPCM output must be 0 after stop" );
		end

		$display( "OK: %0d nibbles from R#0F decoded as reference, nibble period %0d clocks, max |out| %0d",
			c_nibbles, max_decode_gap, max_abs_out );
		test_passed = 1'b1;
		$finish;
	end
endmodule
