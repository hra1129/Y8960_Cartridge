// --------------------------------------------------------------------
//	OPL2 wrapper ADPCM playback test
//	Uses the real 3.579545MHz enable pulse and compares every decoded
//	ADPCM value with ref.txt (generated by gen_adpcm.py).
// --------------------------------------------------------------------
module tb ();
	localparam	clk_base	= 1_000_000_000_000.0 / 42_954_540;
	localparam	c_bytes		= 600;
	localparam	c_nibbles	= c_bytes * 2;
	localparam	c_delta_n	= 16'h8000;
	localparam	c_start		= 16'h0040;					//	4 bytes unit
	localparam	c_stop		= c_start + c_bytes / 4 - 1;
	//	one cen55 every 72 enables, one enable every 12 clocks
	localparam	c_cen55_clks	= 72 * 12;
	localparam	c_play_clks		= c_nibbles * 65536 / c_delta_n * c_cen55_clks;

	reg					clk;
	reg					reset_n;
	reg					enable;
	reg		[3:0]		ff_divider;
	reg					bus_cs;
	reg					bus_address;
	reg					bus_write;
	reg					bus_valid;
	reg		[7:0]		bus_wdata;
	wire				bus_ready;
	wire	[7:0]		bus_rdata;
	wire				bus_rdata_en;
	wire	[15:0]		opl2_sound_out_l;
	wire	[15:0]		opl2_sound_out_r;
	wire				intr_n;
	wire				adpcm_write;
	wire				adpcm_valid;
	wire				adpcm_ready;
	wire	[17:0]		adpcm_address;
	wire	[7:0]		adpcm_wdata;
	reg		[7:0]		adpcm_rdata;
	reg					adpcm_rdata_en;
	reg					test_passed;

	reg		[7:0]		mem [0:262143];
	reg		[7:0]		src [0:c_bytes-1];
	integer				ref_value [0:c_nibbles-1];
	reg		[1:0]		ff_wait;
	reg		[2:0]		ff_rd_pipe;
	reg		[17:0]		ff_rd_addr [0:2];
	integer				decoded_count;
	integer				max_abs_out;

	opl2 u_dut (
		.clk				( clk				),
		.reset_n			( reset_n			),
		.enable				( enable			),
		.bus_cs				( bus_cs			),
		.bus_address		( bus_address		),
		.bus_write			( bus_write			),
		.bus_valid			( bus_valid			),
		.bus_ready			( bus_ready			),
		.bus_wdata			( bus_wdata			),
		.bus_rdata			( bus_rdata			),
		.bus_rdata_en		( bus_rdata_en		),
		.opl2_sound_out_l	( opl2_sound_out_l	),
		.opl2_sound_out_r	( opl2_sound_out_r	),
		.intr_n				( intr_n			),
		.adpcm_write		( adpcm_write		),
		.adpcm_valid		( adpcm_valid		),
		.adpcm_ready		( adpcm_ready		),
		.adpcm_address		( adpcm_address		),
		.adpcm_wdata		( adpcm_wdata		),
		.adpcm_rdata		( adpcm_rdata		),
		.adpcm_rdata_en		( adpcm_rdata_en	)
	);

	always #(clk_base/2) clk = ~clk;

	//	Same enable as y8960_cartridge_tangprimer25k.v (one clock in 12)
	always @( posedge clk ) begin
		if( !reset_n ) begin
			ff_divider	<= 4'd0;
			enable		<= 1'b0;
		end
		else if( ff_divider == 4'd11 ) begin
			ff_divider	<= 4'd0;
			enable		<= 1'b1;
		end
		else begin
			ff_divider	<= ff_divider + 4'd1;
			enable		<= 1'b0;
		end
	end

	//	SRAM: request accepted 2 clocks after valid, read data 3 clocks after acceptance
	assign adpcm_ready = adpcm_valid & (ff_wait == 2'd2);

	always @( posedge clk ) begin
		if( !reset_n ) begin
			ff_wait			<= 2'd0;
			ff_rd_pipe		<= 3'd0;
			adpcm_rdata_en	<= 1'b0;
			adpcm_rdata		<= 8'h00;
		end
		else begin
			if( adpcm_valid && !adpcm_ready ) begin
				ff_wait	<= ff_wait + 2'd1;
			end
			else begin
				ff_wait	<= 2'd0;
			end
			if( adpcm_valid && adpcm_ready && adpcm_write ) begin
				mem[ adpcm_address ] <= adpcm_wdata;
			end
			ff_rd_pipe		<= { ff_rd_pipe[1:0], adpcm_valid & adpcm_ready & ~adpcm_write };
			ff_rd_addr[0]	<= adpcm_address;
			ff_rd_addr[1]	<= ff_rd_addr[0];
			ff_rd_addr[2]	<= ff_rd_addr[1];
			adpcm_rdata_en	<= ff_rd_pipe[2];
			adpcm_rdata		<= ff_rd_pipe[2] ? mem[ ff_rd_addr[2] ] : 8'h00;
		end
	end

	//	Check each decoded value. The decoder pipeline advances on enable,
	//	so the result is read well before the next nibble (>= 864 clocks).
	always @( posedge clk ) begin
		if( u_dut.u_adpcm.u_adpcm.u_decoder.cen &&
		    u_dut.u_adpcm.u_adpcm.u_decoder.adv &&
		    u_dut.u_adpcm.u_adpcm.u_decoder.chon ) begin
			repeat( 200 ) @( posedge clk );
			//	The last nibble is cleared by the end of playback.
			if( decoded_count < c_nibbles - 1 ) begin
				if( $signed( u_dut.u_adpcm.u_adpcm.u_decoder.x1 ) !== ref_value[ decoded_count ] ) begin
					$fatal( 1, "decoded[%0d] expected %0d, actual %0d", decoded_count,
						ref_value[ decoded_count ], $signed( u_dut.u_adpcm.u_adpcm.u_decoder.x1 ) );
				end
			end
			decoded_count = decoded_count + 1;
		end
	end

	//	The jtopl2 output stays X for a while in simulation, which makes saturate_16() report 7FFFh.
	//	Measure only known values of the ADPCM path latched in opl2.v.
	always @( posedge clk ) begin
		if( !$isunknown( u_dut.ff_adpcm_sound_out_l ) ) begin
			if( $signed( u_dut.ff_adpcm_sound_out_l ) > max_abs_out ) max_abs_out = $signed( u_dut.ff_adpcm_sound_out_l );
			if( -$signed( u_dut.ff_adpcm_sound_out_l ) > max_abs_out ) max_abs_out = -$signed( u_dut.ff_adpcm_sound_out_l );
		end
	end

	// ---------------------------------------------------------
	//	Bus tasks
	// ---------------------------------------------------------
	task bus_write_cycle( input a, input [7:0] d );
		@( posedge clk );
		bus_cs		<= 1'b1;
		bus_valid	<= 1'b1;
		bus_write	<= 1'b1;
		bus_address	<= a;
		bus_wdata	<= d;
		@( posedge clk );
		bus_cs		<= 1'b0;
		bus_valid	<= 1'b0;
		bus_write	<= 1'b0;
		repeat( 40 ) @( posedge clk );
	endtask

	task bus_read_cycle( input a, output [7:0] d );
		integer timeout;
		@( posedge clk );
		bus_cs		<= 1'b1;
		bus_valid	<= 1'b1;
		bus_write	<= 1'b0;
		bus_address	<= a;
		@( posedge clk );
		bus_cs		<= 1'b0;
		bus_valid	<= 1'b0;
		timeout		= 0;
		#1;
		while( !bus_rdata_en ) begin
			@( posedge clk );
			#1;
			timeout = timeout + 1;
			if( timeout > 100 ) $fatal( 1, "bus read timeout" );
		end
		d = bus_rdata;
		repeat( 40 ) @( posedge clk );
	endtask

	task write_reg( input [7:0] address, input [7:0] data );
		bus_write_cycle( 1'b0, address );
		bus_write_cycle( 1'b1, data );
	endtask

	task wait_buf_rdy;
		reg		[7:0]	st;
		integer			timeout;
		begin
			timeout = 0;
			bus_read_cycle( 1'b0, st );
			while( !st[3] ) begin
				timeout = timeout + 1;
				if( timeout > 100 ) $fatal( 1, "BUF_RDY timeout" );
				bus_read_cycle( 1'b0, st );
			end
		end
	endtask

	// ---------------------------------------------------------
	//	Test sequence
	// ---------------------------------------------------------
	integer		i;
	integer		play_clks;
	integer		fd;
	integer		value;

	initial begin
		clk				= 1'b0;
		reset_n			= 1'b0;
		bus_cs			= 1'b0;
		bus_address		= 1'b0;
		bus_write		= 1'b0;
		bus_valid		= 1'b0;
		bus_wdata		= 8'd0;
		test_passed		= 1'b0;
		decoded_count	= 0;
		max_abs_out		= 0;
		for( i = 0; i < 262144; i = i + 1 ) begin
			mem[i] = 8'h00;
		end
		$readmemh( "adpcm.hex", src );
		fd = $fopen( "ref.txt", "r" );
		if( fd == 0 ) $fatal( 1, "ref.txt not found" );
		for( i = 0; i < c_nibbles; i = i + 1 ) begin
			if( $fscanf( fd, "%d", value ) != 1 ) $fatal( 1, "ref.txt is too short" );
			ref_value[i] = value;
		end
		$fclose( fd );

		repeat( 20 ) @( posedge clk );
		reset_n = 1'b1;
		repeat( 20 ) @( posedge clk );

		//	Write the sample to ADPCM memory (R#07=60h), polling BUF_RDY
		write_reg( 8'h04, 8'h00 );
		write_reg( 8'h07, 8'h01 );
		write_reg( 8'h08, 8'h00 );
		write_reg( 8'h09, c_start[7:0] );
		write_reg( 8'h0A, c_start[15:8] );
		write_reg( 8'h0B, c_stop[7:0] );
		write_reg( 8'h0C, c_stop[15:8] );
		write_reg( 8'h07, 8'h60 );
		for( i = 0; i < c_bytes; i = i + 1 ) begin
			write_reg( 8'h0F, src[i] );
			wait_buf_rdy;
		end
		write_reg( 8'h07, 8'h01 );
		for( i = 0; i < c_bytes; i = i + 1 ) begin
			if( mem[ { c_start, 2'b00 } + i ] !== src[i] ) begin
				$fatal( 1, "mem[%0h] expected %02h, actual %02h", { c_start, 2'b00 } + i, src[i], mem[ { c_start, 2'b00 } + i ] );
			end
		end
		$display( "OK: %0d bytes written to ADPCM memory", c_bytes );

		//	Playback (R#07=A0h)
		write_reg( 8'h04, 8'h80 );
		write_reg( 8'h10, c_delta_n[7:0] );
		write_reg( 8'h11, c_delta_n[15:8] );
		write_reg( 8'h12, 8'hFF );
		write_reg( 8'h07, 8'hA0 );
		play_clks = 0;
		while( u_dut.u_adpcm.reg_start ) begin
			@( posedge clk );
			play_clks = play_clks + 1;
			if( play_clks > c_play_clks * 2 ) $fatal( 1, "playback did not finish" );
		end
		repeat( 400 ) @( posedge clk );

		if( decoded_count != c_nibbles ) begin
			$fatal( 1, "decoded %0d nibbles, expected %0d", decoded_count, c_nibbles );
		end
		if( play_clks < c_play_clks - 4 * c_cen55_clks || play_clks > c_play_clks + 4 * c_cen55_clks ) begin
			$fatal( 1, "playback length %0d clocks, expected about %0d", play_clks, c_play_clks );
		end
		if( max_abs_out < 4096 ) begin
			$fatal( 1, "ADPCM output is too small (%0d)", max_abs_out );
		end
		$display( "OK: %0d nibbles decoded as reference, playback %0d clocks (expected %0d), max |out| %0d",
			decoded_count, play_clks, c_play_clks, max_abs_out );
		test_passed = 1'b1;
		$finish;
	end
endmodule
